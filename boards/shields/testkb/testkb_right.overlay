#include <dt-bindings/zmk/matrix_transform.h>
#include "testkb_shared.dtsi"

/ {
    kscan0: kscan {
        compatible = "zmk,kscan-gpio-matrix";
        diode-direction = "row2col";
        wakeup-source;

        // Column pins (inputs)
        col-gpios =
            <&gpio0 9 (GPIO_ACTIVE_HIGH | GPIO_PULL_DOWN)>,
            <&gpio1 11 (GPIO_ACTIVE_HIGH | GPIO_PULL_DOWN)>,
            <&gpio1 13 (GPIO_ACTIVE_HIGH | GPIO_PULL_DOWN)>,
            <&gpio0 02 (GPIO_ACTIVE_HIGH | GPIO_PULL_DOWN)>,
            <&gpio0 29 (GPIO_ACTIVE_HIGH | GPIO_PULL_DOWN)>,
            <&gpio0 31 (GPIO_ACTIVE_HIGH | GPIO_PULL_DOWN)>;

        // Row pins (outputs)
        row-gpios =
            <&gpio0 17 GPIO_ACTIVE_HIGH>,
            <&gpio0 20 GPIO_ACTIVE_HIGH>,
            <&gpio0 22 GPIO_ACTIVE_HIGH>,
            <&gpio0 24 GPIO_ACTIVE_HIGH>,
            <&gpio1 0 GPIO_ACTIVE_HIGH>,
            <&gpio0 11 GPIO_ACTIVE_HIGH>,
            <&gpio1 6 GPIO_ACTIVE_HIGH>;
    };

    // shared matrix transform provided by testkb_shared.dtsi

    physical_layout0: physical_layout_0 {
        compatible = "zmk,physical-layout";
        display-name = "Default Layout";
        kscan = <&kscan0>;                // reference to your kscan
        transform = <&default_transform>; // shared transform
    };

    chosen {
        zmk,physical-layout = &physical_layout0;
    };
};