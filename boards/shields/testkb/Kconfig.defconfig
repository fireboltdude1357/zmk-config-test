## boards/shields/testkb/Kconfig.defconfig
```kconfig
if SHIELD_TESTKB

# Name must be less than 16 characters long!
config ZMK_KEYBOARD_NAME
	default "testkb"

endif
```

## boards/shields/testkb/Kconfig.shield
```kconfig
# No whitespace after the comma or in your keyboard name!
config SHIELD_TESTKB_LEFT
	def_bool $(shields_list_contains,testkb_left)
	
	
config SHIELD_TESTKB_RIGHT
	def_bool $(shields_list_contains,testkb_right)
```
